## boards/shields/cosmotyl363/Kconfig.defconfig
```kconfig
if SHIELD_COSMOTYL363_LEFT

config ZMK_KEYBOARD_NAME
    default "Cosmotyl363"

config ZMK_SPLIT_ROLE_CENTRAL
    default y

endif

if SHIELD_COSMOTYL363_LEFT || SHIELD_COSMOTYL363_RIGHT

config ZMK_SPLIT
    default y
endif
```

## boards/shields/cosmotyl363/Kconfig.shield
```kconfig
# Copyright (c) 2024 Dmitrii Mozgovoi
# SPDX-License-Identifier: MIT

config SHIELD_COSMOTYL363_LEFT
    def_bool $(shields_list_contains,cosmotyl363_left)

config SHIELD_COSMOTYL363_RIGHT
    def_bool $(shields_list_contains,cosmotyl363_right)
```

## boards/shields/cosmotyl_3_6_3/Kconfig.defconfig
```kconfig
if SHIELD_COSMOTYL_LEFT

config ZMK_KEYBOARD_NAME
    default "Cosmotyl363"

config ZMK_SPLIT_ROLE_CENTRAL
    default y

endif

if SHIELD_COSMOTYL_LEFT || SHIELD_COSMOTYL_RIGHT

config ZMK_SPLIT
    default y

endif
```
